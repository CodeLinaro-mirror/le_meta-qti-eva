## conf/layer.conf
```bitbake
BBFILES += "${LAYERDIR}/recipes/*/*.bb \
            ${LAYERDIR}/recipes/*/*.bbappend"
BBPATH =. "${LAYERDIR}:"

BBFILE_COLLECTIONS += "qti-eva"
BBFILE_PRIORITY_qti-eva = "12"
BBFILE_PATTERN_qti-eva := "^${LAYERDIR}/"

LAYERSERIES_COMPAT_qti-eva = "dunfell kirkstone scarthgap wrynose"
LAYERVERSION_qti-eva = "1"
LAYERDEPENDS_qti-eva = "core"


TOOLCHAIN:pn-eva       = "sdllvm"
```
